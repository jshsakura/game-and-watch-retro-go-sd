/*
******************************************************************************
**

**  File        : LinkerScript.ld
**
**  Author		: Auto-generated by System Workbench for STM32
**
**  Abstract    : Linker script for STM32H7B0VBTx series
**                128Kbytes FLASH and 1216Kbytes RAM
**
**                Set heap size, stack size and stack location according
**                to application requirements.
**
**                Set memory bank area and size if external memory is used.
**
**  Target      : STMicroelectronics STM32
**
**  Distribution: The file is distributed “as is,” without any warranty
**                of any kind.
**
*****************************************************************************
** @attention
**
** <h2><center>&copy; COPYRIGHT(c) 2019 STMicroelectronics</center></h2>
**
** Redistribution and use in source and binary forms, with or without modification,
** are permitted provided that the following conditions are met:
**   1. Redistributions of source code must retain the above copyright notice,
**      this list of conditions and the following disclaimer.
**   2. Redistributions in binary form must reproduce the above copyright notice,
**      this list of conditions and the following disclaimer in the documentation
**      and/or other materials provided with the distribution.
**   3. Neither the name of STMicroelectronics nor the names of its contributors
**      may be used to endorse or promote products derived from this software
**      without specific prior written permission.
**
** THIS SOFTWARE IS PROVIDED BY THE COPYRIGHT HOLDERS AND CONTRIBUTORS "AS IS"
** AND ANY EXPRESS OR IMPLIED WARRANTIES, INCLUDING, BUT NOT LIMITED TO, THE
** IMPLIED WARRANTIES OF MERCHANTABILITY AND FITNESS FOR A PARTICULAR PURPOSE ARE
** DISCLAIMED. IN NO EVENT SHALL THE COPYRIGHT HOLDER OR CONTRIBUTORS BE LIABLE
** FOR ANY DIRECT, INDIRECT, INCIDENTAL, SPECIAL, EXEMPLARY, OR CONSEQUENTIAL
** DAMAGES (INCLUDING, BUT NOT LIMITED TO, PROCUREMENT OF SUBSTITUTE GOODS OR
** SERVICES; LOSS OF USE, DATA, OR PROFITS; OR BUSINESS INTERRUPTION) HOWEVER
** CAUSED AND ON ANY THEORY OF LIABILITY, WHETHER IN CONTRACT, STRICT LIABILITY,
** OR TORT (INCLUDING NEGLIGENCE OR OTHERWISE) ARISING IN ANY WAY OUT OF THE USE
** OF THIS SOFTWARE, EVEN IF ADVISED OF THE POSSIBILITY OF SUCH DAMAGE.
**
*****************************************************************************
*/

/* Entry Point */
ENTRY(Reset_Handler)

/* Highest address of the user mode stack */
_estack = _stack_top;    /* end of RAM */

/* Generate a link error if heap and stack don't fit into RAM */
_Heap_Size = 81 * 1024;     /* p8ram section removed — PICO-8 allocates from heap at runtime.
                               Trimmed 85->81K to free DTCM after Atari Lynx (MAX_EMULATORS 22)
                               grew emulators[]/systems[]; the stack-padding ASSERT was 64B over. */

_Stack_Redzone_Size = 256;  /* size of stack overflow protection */
_Min_Stack_Size = 24 * 1024; /* required amount of stack */


/* Useful for scripts */
//__NULLPTR_LENGTH__  = 0x100;
__NULLPTR_LENGTH__  = 0x0;
__ITCMRAM_LENGTH__  = 64K;
__DTCMRAM_LENGTH__  = 128K;
__REMOTE_INPUT_RESERVE__ = DEFINED(REMOTE_INPUT) ? REMOTE_INPUT * 12 : 0;
__RAM_UC_LENGTH__   = 300K; /* framebuffer : 2 x 320 x 240 x 16 bits */
__RAM_EMU_LENGTH__  = 1024K - __RAM_UC_LENGTH__;
__AHBRAM_LENGTH__   = 128K;
__AHBRAM_AUDIO_RESERVE__ = 8K; /* MPU non-cacheable slot for .audio DMA buffer at end of AHB SRAM */
__FLASH_LENGTH__    = 256K; /* Bank 1 */
__FLASH2_LENGTH__   = 256K; /* Bank 2 */
__RAM_FCEUMM_MAPPER_LENGTH__ = 48K; /* Current FCEUMM mapper code */

/* Usefull only for round robin flash allocator */
__EXTFLASH_OFFSET__ = DEFINED(__EXTFLASH_OFFSET__) ? __EXTFLASH_OFFSET__ : 0;  /* bytes reserved at the bottom by the chainloader */
__EXTFLASH_BASE__ = 0x90000000;  /* Beginning of addressable extflash addresses */
__EXTFLASH_START__ = __EXTFLASH_BASE__ + __EXTFLASH_OFFSET__;  /* Beginning of where we're going to store emulator and rom data (respect the reserved offset, matching STM32H7B0VBTx_FLASH.ld) */

__RAM_START__       = 0x24000000;
__RAM_UC_START__    = __RAM_START__;
__RAM_EMU_START__   = __RAM_START__ + __RAM_UC_LENGTH__;

__RAM_FCEUMM_START__   = __RAM_START__ + __RAM_UC_LENGTH__ + __RAM_FCEUMM_MAPPER_LENGTH__;

__RAM_EMU_END__     = __RAM_EMU_START__ + __RAM_EMU_LENGTH__;
__RAM_END__         = __RAM_START__ + 1024K;

__INTFLASH__ = DEFINED(__INTFLASH__) ? __INTFLASH__ : 0x08000000;

/* Specify the memory areas */
MEMORY
{
  /* RAM */
  NULLPTR  (xrw) : ORIGIN = 0x00000000, LENGTH =   __NULLPTR_LENGTH__
  ITCMRAM  (xrw) : ORIGIN = 0x00000000 + __NULLPTR_LENGTH__, LENGTH = __ITCMRAM_LENGTH__ - __NULLPTR_LENGTH__
  DTCMRAM  (xrw) : ORIGIN = 0x20000000, LENGTH =  __DTCMRAM_LENGTH__
  RAM_UC   (xrw) : ORIGIN = __RAM_UC_START__, LENGTH = __RAM_UC_LENGTH__
  RAM_EMU  (xrw) : ORIGIN = __RAM_EMU_START__, LENGTH = __RAM_EMU_LENGTH__
  RAM_FCEUMM  (xrw) : ORIGIN = __RAM_FCEUMM_START__, LENGTH = __RAM_EMU_LENGTH__ - __RAM_FCEUMM_MAPPER_LENGTH__
  AHBRAM   (xrw) : ORIGIN = 0x30000000, LENGTH =  __AHBRAM_LENGTH__

  /* FLASH */
  FLASH    (xr ) : ORIGIN = __INTFLASH__,        LENGTH =  __FLASH_LENGTH__

  /* CORES */
  CORES    (x)   : ORIGIN = 0x0,                 LENGTH = 0xFFFFFFFF

  /* RODATA */
  RODATA   (x)   : ORIGIN = 0xCAFE0000,   LENGTH = 0xFFFFFFFF

  /* PICO-8 code (sentinel address, patched to QSPI XIP at runtime) */
  PICO8_CODE (x) : ORIGIN = 0xBEEF0000,   LENGTH = 512K

  /* DOOM rodata (sentinel address, patched to QSPI XIP at runtime). Mirrors the
     DOOM_CODE sentinel in STM32H7B0VBTx_FLASH.ld so rg_emulators.c (DOOM_CODE_BASE)
     and the doom.ro extraction work identically in the SD build. */
  DOOM_CODE  (x) : ORIGIN = 0xD00D0000,   LENGTH = 1024K

  /* External flash (QSPI XIP) — for ITCM hot code LMA */
  EXTFLASH   (xr) : ORIGIN = __EXTFLASH_START__, LENGTH = 32M
}


/* Define output sections */
SECTIONS
{
  ._itcram :
  {
    __itcram_start__ = .;
  } > ITCMRAM

  /* ITCM hot code section — empty in GPL stub build.
     The separately-distributed engine binary loads its own ITCM code
     from /cores/pico8_itcm.bin at runtime. */
  ._itcram_hot :
  {
    __itcram_hot_start__ = .;
    __itcram_hot_end__ = .;
    __itcram_end__ = .;
  } > ITCMRAM

  /* Uncached and unbuffered LCD framebuffer pool. Sized for the largest
   * supported mode (2x RGB565 framebuffers = 300K). lcd_setup_framebuffers()
   * carves it up at boot via __lcd_pool_start__; in LUT8 mode the upper
   * ~154K is freed as a "bonus pool" (lcd_get_bonus_pool()) that PICO-8
   * folds into its TLSF allocator via g_platform.scratch_base/size. */
  ._ram_uc (NOLOAD) :
  {
    __ram_uc_start__ = .;
    . = ALIGN(16);
    __lcd_pool_start__ = .;
    . = . + __RAM_UC_LENGTH__;
    __lcd_pool_end__ = .;
    __ram_uc_end__ = .;
  } > RAM_UC

  .sd_fonts_cp1251_greybeard : {
    . = ALIGN(4);
    KEEP(*(.sd_fonts_cp1251_greybeard))
  } > CORES

  .sd_fonts_cp1251_sans_serif_bold : {
    . = ALIGN(4);
    KEEP(*(.sd_fonts_cp1251_sans_serif_bold))
  } > CORES

  .sd_fonts_cp1251_sans_serif : {
    . = ALIGN(4);
    KEEP(*(.sd_fonts_cp1251_sans_serif))
  } > CORES

  .sd_fonts_cp1251_serif_bold : {
    . = ALIGN(4);
    KEEP(*(.sd_fonts_cp1251_serif_bold))
  } > CORES

  .sd_fonts_cp1251_serif : {
    . = ALIGN(4);
    KEEP(*(.sd_fonts_cp1251_serif))
  } > CORES

  .sd_fonts_cp1252_greybeard : {
    . = ALIGN(4);
    KEEP(*(.sd_fonts_cp1252_greybeard))
  } > CORES

  .sd_fonts_cp1252_haeberli12 : {
    . = ALIGN(4);
    KEEP(*(.sd_fonts_cp1252_haeberli12))
  } > CORES

  .sd_fonts_cp1252_rock12 : {
    . = ALIGN(4);
    KEEP(*(.sd_fonts_cp1252_rock12))
  } > CORES

  .sd_fonts_cp1252_sans_serif_bold : {
    . = ALIGN(4);
    KEEP(*(.sd_fonts_cp1252_sans_serif_bold))
  } > CORES

  .sd_fonts_cp1252_sans_serif : {
    . = ALIGN(4);
    KEEP(*(.sd_fonts_cp1252_sans_serif))
  } > CORES

  .sd_fonts_cp1252_serif_bold : {
    . = ALIGN(4);
    KEEP(*(.sd_fonts_cp1252_serif_bold))
  } > CORES

  .sd_fonts_cp1252_serif_cjk : {
    . = ALIGN(4);
    KEEP(*(.sd_fonts_cp1252_serif_cjk))
  } > CORES

  .sd_fonts_cp1252_serif : {
    . = ALIGN(4);
    KEEP(*(.sd_fonts_cp1252_serif))
  } > CORES

  .sd_fonts_cp1252_unbalanced : {
    . = ALIGN(4);
    KEEP(*(.sd_fonts_cp1252_unbalanced))
  } > CORES

  .sd_fonts_unicode_katakana : {
    . = ALIGN(4);
    KEEP(*(.sd_fonts_unicode_katakana))
  } > CORES

  .sd_fonts_unicode_kanji : {
    . = ALIGN(4);
    KEEP(*(.sd_fonts_unicode_kanji))
  } > CORES

INCLUDE build/fceumm_mappers.ld

  .overlay_nes_fceu __RAM_FCEUMM_START__ : {
    . = ALIGN(4);
    __ram_emu_nes_fceu_start__ = .;
    build/nes_fceu/*.o (.data .data* .text .text* .rodata .rodata*)
    . = ALIGN(4);
    _OVERLAY_NES_FCEU_LOAD_END = .;
  } AT > CORES
  _OVERLAY_NES_FCEU_LOAD_START = LOADADDR(.overlay_nes_fceu);
  _OVERLAY_NES_FCEU_SIZE = SIZEOF(.overlay_nes_fceu);

  .overlay_nes_fceu_bss _OVERLAY_NES_FCEU_LOAD_END : {
    . = ALIGN(4);
    _OVERLAY_NES_FCEU_BSS_START = .;
    build/nes_fceu/*.o (.bss .bss*)
    . = ALIGN(4);
    build/nes_fceu/*.o (COMMON)
    . = ALIGN(4);
    _OVERLAY_NES_FCEU_BSS_END = .;
    __ram_emu_nes_fceu_end__ = .;
    ASSERT(ABSOLUTE(_OVERLAY_NES_FCEU_BSS_END) < __RAM_EMU_END__, "Error: NES_FCEU BSS overflow");
  }
  _OVERLAY_NES_FCEU_BSS_SIZE = SIZEOF(.overlay_nes_fceu_bss);

  .overlay_tgb __RAM_EMU_START__ : {
    . = ALIGN(4);
    __ram_emu_tgb_start__ = .;
    __init_array_tgb_start__ = .;
    KEEP(build/tgbdual/*.o(.init_array*))
    __init_array_tgb_end__ = .;
    build/tgbdual/*.o (.data .data* .text .text* .text.* .rodata .rodata* .ARM.extab.text.* .ARM.exidx.text.* )
    . = ALIGN(4);
    _OVERLAY_TGB_LOAD_END = .;
  } AT > CORES
  _OVERLAY_TGB_LOAD_START = LOADADDR(.overlay_tgb);
  _OVERLAY_TGB_SIZE = SIZEOF(.overlay_tgb);

  .overlay_tgb_bss _OVERLAY_TGB_LOAD_END : {
    . = ALIGN(4);
    _OVERLAY_TGB_BSS_START = .;
    build/tgbdual/*.o (COMMON)
    . = ALIGN(4);
    build/tgbdual/*.o (.bss .bss*)
    _OVERLAY_TGB_BSS_END = .;
    __ram_emu_tgb_end__ = .;
    ASSERT(ABSOLUTE(_OVERLAY_TGB_BSS_END) < __RAM_EMU_END__, "Error: TGB BSS overflow");
  }
  _OVERLAY_TGB_BSS_SIZE = SIZEOF(.overlay_tgb_bss);

  .overlay_sms __RAM_EMU_START__ : {
      . = ALIGN(4);
    __ram_emu_sms_start__ = .;
      build/smsplusgx/*.o (.data .data* .text .text* .rodata .rodata*)
      . = ALIGN(4);
      _OVERLAY_SMS_LOAD_END = .;
  } AT > CORES
  _OVERLAY_SMS_LOAD_START = LOADADDR(.overlay_sms);
  _OVERLAY_SMS_SIZE = SIZEOF(.overlay_sms);

  .overlay_sms_bss _OVERLAY_SMS_LOAD_END : {
    . = ALIGN(4);
    _OVERLAY_SMS_BSS_START = .;
    build/smsplusgx/*.o (.bss .bss*)
    . = ALIGN(4);
    build/smsplusgx/*.o (COMMON)
    __ram_emu_sms_end__ = .;
    _OVERLAY_SMS_BSS_END = .;
    ASSERT(ABSOLUTE(_OVERLAY_SMS_BSS_END) < __RAM_EMU_END__, "Error: SMS BSS overflow");
  }
  _OVERLAY_SMS_BSS_SIZE = SIZEOF(.overlay_sms_bss);

  .coleco_bios_data : {
    . = ALIGN(4);
    KEEP(*(.coleco_bios_data))
  } > CORES

  .overlay_pce __RAM_EMU_START__ : {
      . = ALIGN(4);
    __ram_emu_pce_start__ = .;
      build/pce/*.o (.data .data* .text .text* .rodata .rodata*)
      . = ALIGN(4);
      _OVERLAY_PCE_LOAD_END = .;
  } AT > CORES
  _OVERLAY_PCE_LOAD_START = LOADADDR(.overlay_pce);
  _OVERLAY_PCE_SIZE = SIZEOF(.overlay_pce);

  .overlay_pce_bss _OVERLAY_PCE_LOAD_END : {
    . = ALIGN(4);
    _OVERLAY_PCE_BSS_START = .;
    build/pce/*.o (.bss .bss*)
    . = ALIGN(4);
    build/pce/*.o (COMMON)
    . = ALIGN(4);
    _PCE_ROM_UNPACK_BUFFER = .;
    _OVERLAY_PCE_BSS_END = .;
    __ram_emu_pce_end__ = .;
    _OVERLAY_PCE_BSS_END = .;
    ASSERT(ABSOLUTE(_OVERLAY_PCE_BSS_END) < __RAM_EMU_END__, "Error: PCE BSS overflow");
  }
  _OVERLAY_PCE_BSS_SIZE = SIZEOF(.overlay_pce_bss);
  _PCE_ROM_UNPACK_BUFFER_SIZE = __RAM_EMU_START__ + __RAM_EMU_LENGTH__ - _PCE_ROM_UNPACK_BUFFER;

  .overlay_msx __RAM_EMU_START__ : {
    . = ALIGN(4);
    __ram_emu_msx_start__ = .;
    build/msx/*.o (.data .data* .text .text* .rodata .rodata*)
    . = ALIGN(4);
    _OVERLAY_MSX_LOAD_END = .;
  } AT > CORES
  _OVERLAY_MSX_LOAD_START = LOADADDR(.overlay_msx);
  _OVERLAY_MSX_SIZE = SIZEOF(.overlay_msx);
  .overlay_msx_bss _OVERLAY_MSX_LOAD_END : {
    . = ALIGN(4);
    _OVERLAY_MSX_BSS_START = .;
    build/msx/*.o (.bss .bss*)
    . = ALIGN(4);
    build/msx/*.o (COMMON)
    _MSX_ROM_UNPACK_BUFFER = .;
    __ram_emu_msx_end__ = .;
    _OVERLAY_MSX_BSS_END = .;
    ASSERT(ABSOLUTE(_OVERLAY_MSX_BSS_END) < __RAM_EMU_END__, "Error: MSX BSS overflow");
  }
  _OVERLAY_MSX_BSS_SIZE = SIZEOF(.overlay_msx_bss);
  _MSX_ROM_UNPACK_BUFFER_SIZE = __RAM_EMU_START__ + __RAM_EMU_LENGTH__ - _MSX_ROM_UNPACK_BUFFER;

  .overlay_wsv __RAM_EMU_START__ : {
    . = ALIGN(4);
    __ram_emu_wsv_start__ = .;
    build/wsv/*.o (.data .data* .text .text* .rodata .rodata*)
    . = ALIGN(4);
    _OVERLAY_WSV_LOAD_END = .;
  } AT > CORES
  _OVERLAY_WSV_LOAD_START = LOADADDR(.overlay_wsv);
  _OVERLAY_WSV_SIZE = SIZEOF(.overlay_wsv);
  .overlay_wsv_bss _OVERLAY_WSV_LOAD_END : {
    . = ALIGN(4);
    _OVERLAY_WSV_BSS_START = .;
    build/wsv/*.o (.bss .bss*)
    . = ALIGN(4);
    build/wsv/*.o (COMMON)
    __ram_emu_wsv_end__ = .;
    _OVERLAY_WSV_BSS_END = .;
    ASSERT(ABSOLUTE(_OVERLAY_WSV_BSS_END) < __RAM_EMU_END__, "Error: WSV BSS overflow");
  }
  _OVERLAY_WSV_BSS_SIZE = SIZEOF(.overlay_wsv_bss);

  .overlay_ngp __RAM_EMU_START__ : {
    . = ALIGN(4);
    __ram_emu_ngp_start__ = .;
    build/ngp/*.o (.data .data* .text .text* .rodata .rodata*)
    . = ALIGN(4);
    _OVERLAY_NGP_LOAD_END = .;
  } AT > CORES
  _OVERLAY_NGP_LOAD_START = LOADADDR(.overlay_ngp);
  _OVERLAY_NGP_SIZE = SIZEOF(.overlay_ngp);
  .overlay_ngp_bss _OVERLAY_NGP_LOAD_END : {
    . = ALIGN(4);
    _OVERLAY_NGP_BSS_START = .;
    build/ngp/*.o (.bss .bss*)
    . = ALIGN(4);
    build/ngp/*.o (COMMON)
    __ram_emu_ngp_end__ = .;
    _OVERLAY_NGP_BSS_END = .;
    ASSERT(ABSOLUTE(_OVERLAY_NGP_BSS_END) < __RAM_EMU_END__, "Error: NGP BSS overflow");
  }
  _OVERLAY_NGP_BSS_SIZE = SIZEOF(.overlay_ngp_bss);

  .overlay_wswan __RAM_EMU_START__ : {
    . = ALIGN(4);
    __ram_emu_wswan_start__ = .;
    build/wswan/*.o (.data .data* .text .text* .rodata .rodata*)
    . = ALIGN(4);
    _OVERLAY_WSWAN_LOAD_END = .;
  } AT > CORES
  _OVERLAY_WSWAN_LOAD_START = LOADADDR(.overlay_wswan);
  _OVERLAY_WSWAN_SIZE = SIZEOF(.overlay_wswan);
  .overlay_wswan_bss _OVERLAY_WSWAN_LOAD_END : {
    . = ALIGN(4);
    _OVERLAY_WSWAN_BSS_START = .;
    build/wswan/*.o (.bss .bss*)
    . = ALIGN(4);
    build/wswan/*.o (COMMON)
    __ram_emu_wswan_end__ = .;
    _OVERLAY_WSWAN_BSS_END = .;
    ASSERT(ABSOLUTE(_OVERLAY_WSWAN_BSS_END) < __RAM_EMU_END__, "Error: WSWAN BSS overflow");
  }
  _OVERLAY_WSWAN_BSS_SIZE = SIZEOF(.overlay_wswan_bss);

  .overlay_gw __RAM_EMU_START__ : {
    . = ALIGN(4);
    __ram_emu_gw_start__ = .;
    build/gw/*.o (.data .data* .text .text* .rodata .rodata*)
    . = ALIGN(4);
    _OVERLAY_GW_LOAD_END = .;
  } AT > CORES
  _OVERLAY_GW_LOAD_START = LOADADDR(.overlay_gw);
  _OVERLAY_GW_SIZE = SIZEOF(.overlay_gw);

  .overlay_gw_bss _OVERLAY_GW_LOAD_END : {
    . = ALIGN(4);
    _OVERLAY_GW_BSS_START = .;
    build/gw/*.o (.bss .bss*)
    . = ALIGN(4);
    build/gw/*.o (COMMON)
    __ram_emu_gw_end__ = .;
    _OVERLAY_GW_BSS_END = .;
    ASSERT(ABSOLUTE(_OVERLAY_GW_BSS_END) < __RAM_EMU_END__, "Error: GW BSS overflow");
  }
  _OVERLAY_GW_BSS_SIZE = SIZEOF(.overlay_gw_bss);

  .overlay_md __RAM_EMU_START__ : {
    . = ALIGN(4);
    __ram_emu_md_start__ = .;
    build/md/*.o (.data .data* .text .text* .rodata .rodata*)
    . = ALIGN(4);
    _OVERLAY_MD_LOAD_END = .;
  } AT > CORES
  _OVERLAY_MD_LOAD_START = LOADADDR(.overlay_md);
  _OVERLAY_MD_SIZE = SIZEOF(.overlay_md);

  .overlay_md_bss _OVERLAY_MD_LOAD_END : {
    . = ALIGN(4);
    _OVERLAY_MD_BSS_START = .;
    build/md/*.o (.bss .bss*)
    . = ALIGN(4);
    build/md/*.o (COMMON)
    __ram_emu_md_end__ = .;
    _OVERLAY_MD_BSS_END = .;
    ASSERT(ABSOLUTE(_OVERLAY_MD_BSS_END) < __RAM_EMU_END__, "Error: MD BSS overflow");
  }
  _OVERLAY_MD_BSS_SIZE = SIZEOF(.overlay_md_bss);

  .overlay_a2600 __RAM_EMU_START__ : {
    . = ALIGN(4);
    __ram_emu_a2600_start__ = .;
    __init_array_a2600_start__ = .;
    KEEP(build/a2600/*.o(.init_array*))
    __init_array_a2600_end__ = .;
    build/a2600/*.o (.data .data* .text .text* .rodata .rodata* .ARM.extab.text.* .ARM.exidx.text.*)
    . = ALIGN(4);
    _OVERLAY_A2600_LOAD_END = .;
  } AT > CORES
  _OVERLAY_A2600_LOAD_START = LOADADDR(.overlay_a2600);
  _OVERLAY_A2600_SIZE = SIZEOF(.overlay_a2600);

  .overlay_a2600_bss _OVERLAY_A2600_LOAD_END : {
    . = ALIGN(4);
    _OVERLAY_A2600_BSS_START = .;
    build/a2600/*.o (COMMON)
    . = ALIGN(4);
    build/a2600/*.o (.bss .bss*)
    _OVERLAY_A2600_BSS_END = .;
    __ram_emu_a2600_end__ = .;
    ASSERT(ABSOLUTE(_OVERLAY_A2600_BSS_END) < __RAM_EMU_END__, "Error: A2600 BSS overflow");
  }
  _OVERLAY_A2600_BSS_SIZE = SIZEOF(.overlay_a2600_bss);

  /* Lynx (handy) — plain RAM overlay: whole core runs from RAM_EMU, exactly like
     .overlay_a2600. (Earlier code-in-flash XIP was reverted: a2600/other C++
     cores prove RAM overlays work, and the XIP sentinel-patching corrupted
     main_lynx.) */
  .overlay_lynx __RAM_EMU_START__ : {
    . = ALIGN(4);
    __ram_emu_lynx_start__ = .;
    __init_array_lynx_start__ = .;
    KEEP(build/lynx/*.o(.init_array*))
    __init_array_lynx_end__ = .;
    build/lynx/*.o (.data .data* .text .text* .rodata .rodata* .ARM.extab.text.* .ARM.exidx.text.*)
    . = ALIGN(4);
    _OVERLAY_LYNX_LOAD_END = .;
  } AT > CORES
  _OVERLAY_LYNX_LOAD_START = LOADADDR(.overlay_lynx);
  _OVERLAY_LYNX_SIZE = SIZEOF(.overlay_lynx);

  .overlay_lynx_bss _OVERLAY_LYNX_LOAD_END : {
    . = ALIGN(4);
    _OVERLAY_LYNX_BSS_START = .;
    build/lynx/*.o (COMMON)
    . = ALIGN(4);
    build/lynx/*.o (.bss .bss*)
    _OVERLAY_LYNX_BSS_END = .;
    __ram_emu_lynx_end__ = .;
    ASSERT(ABSOLUTE(_OVERLAY_LYNX_BSS_END) < __RAM_EMU_END__, "Error: LYNX BSS overflow");
  }
  _OVERLAY_LYNX_BSS_SIZE = SIZEOF(.overlay_lynx_bss);

  .overlay_a7800 __RAM_EMU_START__ : {
    . = ALIGN(4);
    __ram_emu_a7800_start__ = .;
    build/a7800/*.o (.data .data* .text .text* .rodata .rodata*)
    . = ALIGN(4);
    _OVERLAY_A7800_LOAD_END = .;
  } AT > CORES
  _OVERLAY_A7800_LOAD_START = LOADADDR(.overlay_a7800);
  _OVERLAY_A7800_SIZE = SIZEOF(.overlay_a7800);

  .overlay_a7800_bss _OVERLAY_A7800_LOAD_END : {
    . = ALIGN(4);
    _OVERLAY_A7800_BSS_START = .;
    build/a7800/*.o (.bss .bss*)
    . = ALIGN(4);
    build/a7800/*.o (COMMON)
    __ram_emu_a7800_end__ = .;
    _OVERLAY_A7800_BSS_END = .;
    ASSERT(ABSOLUTE(_OVERLAY_A7800_BSS_END) < __RAM_EMU_END__, "Error: A7800 BSS overflow");
  }
  _OVERLAY_A7800_BSS_SIZE = SIZEOF(.overlay_a7800_bss);

  .overlay_amstrad __RAM_EMU_START__ : {
    . = ALIGN(4);
    __ram_emu_amstrad_start__ = .;
    build/amstrad/*.o (.data .data* .text .text* .rodata .rodata*)
    . = ALIGN(4);
    _OVERLAY_AMSTRAD_LOAD_END = .;
  } AT > CORES
  _OVERLAY_AMSTRAD_LOAD_START = LOADADDR(.overlay_amstrad);
  _OVERLAY_AMSTRAD_SIZE = SIZEOF(.overlay_amstrad);

  .overlay_amstrad_bss _OVERLAY_AMSTRAD_LOAD_END : {
    . = ALIGN(4);
    _OVERLAY_AMSTRAD_BSS_START = .;
    build/amstrad/*.o (.bss .bss*)
    . = ALIGN(4);
    build/amstrad/*.o (COMMON)
    __ram_emu_amstrad_end__ = .;
    _OVERLAY_AMSTRAD_BSS_END = .;
    ASSERT(ABSOLUTE(_OVERLAY_AMSTRAD_BSS_END) < __RAM_EMU_END__, "Error: AMSTRAD BSS overflow");
  }
  _OVERLAY_AMSTRAD_BSS_SIZE = SIZEOF(.overlay_amstrad_bss);

  .overlay_zelda3 __RAM_EMU_START__ : {
    . = ALIGN(4);
    __ram_emu_zelda3_start__ = .;
    _ZELDA3_MAIN_CODE_START = .;
    build/zelda3/main_zelda3.o (.data .data* .text .text* .rodata .rodata*)
    _ZELDA3_MAIN_CODE_END = .;
    build/zelda3/*.o (.data .data* .text .text* .noreloc)
    . = ALIGN(4);
    _OVERLAY_ZELDA3_LOAD_END = .;
  } AT > CORES
  _OVERLAY_ZELDA3_LOAD_START = LOADADDR(.overlay_zelda3);
  _OVERLAY_ZELDA3_SIZE = SIZEOF(.overlay_zelda3);

  .overlay_zelda3_bss _OVERLAY_ZELDA3_LOAD_END : {
    . = ALIGN(4);
    _OVERLAY_ZELDA3_BSS_START = .;
    build/zelda3/*.o (.bss .bss*)
    . = ALIGN(4);
    build/zelda3/*.o (COMMON)
    __ram_emu_zelda3_end__ = .;
    _OVERLAY_ZELDA3_BSS_END = .;
    ASSERT(ABSOLUTE(_OVERLAY_ZELDA3_BSS_END) < __RAM_EMU_END__, "Error: ZELDA3 BSS overflow");
  }
  _OVERLAY_ZELDA3_BSS_SIZE = SIZEOF(.overlay_zelda3_bss);

  .rodata_zelda3 :
  {
    . = ALIGN(4);
    . = ALIGN(4);
    __rodata_zelda3_start__ = .;
    build/zelda3/*.o (.rodata .rodata*)
    __rodata_zelda3_end__ = .;
  } > RODATA

  .overlay_smw __RAM_EMU_START__ : {
    . = ALIGN(4);
    __ram_emu_smw_start__ = .;
    build/smw/*.o (.data .data* .text .text* .rodata .rodata*)
    . = ALIGN(4);
    _OVERLAY_SMW_LOAD_END = .;
  } AT > CORES
  _OVERLAY_SMW_LOAD_START = LOADADDR(.overlay_smw);
  _OVERLAY_SMW_SIZE = SIZEOF(.overlay_smw);

  .overlay_smw_bss _OVERLAY_SMW_LOAD_END : {
    . = ALIGN(4);
    _OVERLAY_SMW_BSS_START = .;
    build/smw/*.o (.bss .bss*)
    . = ALIGN(4);
    build/smw/*.o (COMMON)
    __ram_emu_smw_end__ = .;
    _OVERLAY_SMW_BSS_END = .;
    ASSERT(ABSOLUTE(_OVERLAY_SMW_BSS_END) < __RAM_EMU_END__, "Error: SMW BSS overflow");
  }
  _OVERLAY_SMW_BSS_SIZE = SIZEOF(.overlay_smw_bss);

  .overlay_videopac __RAM_EMU_START__ : {
    . = ALIGN(4);
    __ram_emu_videopac_start__ = .;
    build/videopac/*.o (.data .data* .text .text* .rodata .rodata*)
    . = ALIGN(4);
    _OVERLAY_VIDEOPAC_LOAD_END = .;
  } AT > CORES
  _OVERLAY_VIDEOPAC_LOAD_START = LOADADDR(.overlay_videopac);
  _OVERLAY_VIDEOPAC_SIZE = SIZEOF(.overlay_videopac);

  .overlay_videopac_bss _OVERLAY_VIDEOPAC_LOAD_END : {
    . = ALIGN(4);
    _OVERLAY_VIDEOPAC_BSS_START = .;
    build/videopac/*.o (.bss .bss*)
    . = ALIGN(4);
    build/videopac/*.o (COMMON)
    __ram_emu_videopac_end__ = .;
    _OVERLAY_VIDEOPAC_BSS_END = .;
    ASSERT(ABSOLUTE(_OVERLAY_VIDEOPAC_BSS_END) < __RAM_EMU_END__, "Error: VIDEOPAC BSS overflow");
  }
  _OVERLAY_VIDEOPAC_BSS_SIZE = SIZEOF(.overlay_videopac_bss);

  .overlay_zx __RAM_EMU_START__ : {
    . = ALIGN(4);
    __ram_emu_zx_start__ = .;
    build/zx/*.o (.data .data* .text .text* .rodata .rodata*)
    . = ALIGN(4);
    _OVERLAY_ZX_LOAD_END = .;
  } AT > CORES
  _OVERLAY_ZX_LOAD_START = LOADADDR(.overlay_zx);
  _OVERLAY_ZX_SIZE = SIZEOF(.overlay_zx);

  .overlay_zx_bss _OVERLAY_ZX_LOAD_END : {
    . = ALIGN(4);
    _OVERLAY_ZX_BSS_START = .;
    build/zx/*.o (.bss .bss*)
    . = ALIGN(4);
    build/zx/*.o (COMMON)
    __ram_emu_zx_end__ = .;
    _OVERLAY_ZX_BSS_END = .;
    ASSERT(ABSOLUTE(_OVERLAY_ZX_BSS_END) < __RAM_EMU_END__, "Error: ZX BSS overflow");
  }
  _OVERLAY_ZX_BSS_SIZE = SIZEOF(.overlay_zx_bss);

  .overlay_celeste __RAM_EMU_START__ : {
    . = ALIGN(4);
    __ram_emu_celeste_start__ = .;
    build/celeste/*.o (.data .data* .text .text* .rodata .rodata*)
    . = ALIGN(4);
    _OVERLAY_CELESTE_LOAD_END = .;
  } AT > CORES
  _OVERLAY_CELESTE_LOAD_START = LOADADDR(.overlay_celeste);
  _OVERLAY_CELESTE_SIZE = SIZEOF(.overlay_celeste);

  .overlay_celeste_bss _OVERLAY_CELESTE_LOAD_END : {
    . = ALIGN(4);
    _OVERLAY_CELESTE_BSS_START = .;
    build/celeste/*.o (.bss .bss*)
    . = ALIGN(4);
    build/celeste/*.o (COMMON)
    __ram_emu_celeste_end__ = .;
    _OVERLAY_CELESTE_BSS_END = .;
    ASSERT(ABSOLUTE(_OVERLAY_CELESTE_BSS_END) < __RAM_EMU_END__, "Error: CELESTE BSS overflow");
  }
  _OVERLAY_CELESTE_BSS_SIZE = SIZEOF(.overlay_celeste_bss);

  .overlay_music __RAM_EMU_START__ : {
    . = ALIGN(4);
    __ram_emu_music_start__ = .;
    build/music/*.o (.data .data* .text .text* .rodata .rodata*)
    . = ALIGN(4);
    _OVERLAY_MUSIC_LOAD_END = .;
  } AT > CORES
  _OVERLAY_MUSIC_LOAD_START = LOADADDR(.overlay_music);
  _OVERLAY_MUSIC_SIZE = SIZEOF(.overlay_music);

  .overlay_music_bss _OVERLAY_MUSIC_LOAD_END : {
    . = ALIGN(4);
    _OVERLAY_MUSIC_BSS_START = .;
    build/music/*.o (.bss .bss*)
    . = ALIGN(4);
    build/music/*.o (COMMON)
    __ram_emu_music_end__ = .;
    _OVERLAY_MUSIC_BSS_END = .;
    ASSERT(ABSOLUTE(_OVERLAY_MUSIC_BSS_END) < __RAM_EMU_END__, "Error: MUSIC BSS overflow");
  }
  _OVERLAY_MUSIC_BSS_SIZE = SIZEOF(.overlay_music_bss);

  /* DOOM (doomgeneric) homebrew overlay — same RAM_EMU VMA, LMA in EXTFLASH.
     Shipped as /roms/homebrew/Doom.bin and cached into RAM at launch. */
  .overlay_doom __RAM_EMU_START__ : {
    . = ALIGN(4);
    __ram_emu_doom_start__ = .;
    /* CODE-IN-FLASH model (next-hack style): the ONLY DOOM .text kept in RAM is
       main_doom.o, because the firmware (rg_emulators.c) calls app_main_doom()
       directly and the entry must not sit at the unpatched XIP sentinel. Its
       internal refs to XIP functions ARE patched (this overlay is scanned by
       PatchDoomRegion). ALL other DOOM .text + .rodata runs XIP from flash via
       .doom_xip below. Eliminating RAM-resident renderer/game code removes the
       RAM->flash code veneers whose machinery corrupted a return address and
       HardFaulted on the first input poll (pc landed in the thintriangle_guy
       data table). Only writable .data stays in RAM. */
    build/doom/main_doom*.o (.data .data* .text .text* .rodata .rodata*)
    /* all remaining doom .data must stay writable in RAM */
    build/doom/*.o (.data .data*)
    /* --- next-hack engine (USE_NHDOOM, Phase 2): device_main.o is the entry
       HAL the firmware calls directly, so it stays RAM-resident (like
       main_doom.o); all other engine .text/.rodata runs XIP via .doom_xip.
       Engine writable .data stays in RAM. These lines are empty when
       USE_NHDOOM=0 (build/nhdoom/*.o is not built). --- */
    build/nhdoom/device_main*.o (.data .data* .text .text* .rodata .rodata*)
    build/nhdoom/*.o (.data .data*)
    . = ALIGN(4);
    _OVERLAY_DOOM_LOAD_END = .;
  } AT > CORES
  _OVERLAY_DOOM_LOAD_START = LOADADDR(.overlay_doom);
  _OVERLAY_DOOM_SIZE = SIZEOF(.overlay_doom);

  /* Non-hot DOOM code + read-only data, run in place (XIP) from external flash.
     VMA == LMA at the DOOM_CODE sentinel (0xD00D0000); extracted to
     /roms/homebrew/doom.ro, cached to QSPI flash and relocated at launch
     (DoomCacheCodeToFlash + PatchDoomRegion in rg_emulators.c patch the sentinel
     refs in both the RAM overlay and the blob; a D-cache invalidate after the
     flash reprogram makes the patched bytes visible). */
  .doom_xip : {
    . = ALIGN(4);
    __doom_xip_start__ = .;
    build/doom/*.o (.text .text* .rodata .rodata*)
    /* next-hack engine code/rodata, XIP from external flash (empty when
       USE_NHDOOM=0). device_main.o is excluded -- it is RAM-resident above. */
    build/nhdoom/*.o (.text .text* .rodata .rodata*)
    . = ALIGN(4);
    __doom_xip_end__ = .;
  } > DOOM_CODE
  _DOOM_XIP_SIZE = SIZEOF(.doom_xip);

  .overlay_doom_bss _OVERLAY_DOOM_LOAD_END : {
    . = ALIGN(4);
    _OVERLAY_DOOM_BSS_START = .;
    build/doom/*.o (.bss .bss*)
    . = ALIGN(4);
    build/doom/*.o (COMMON)
    __ram_emu_doom_end__ = .;
    _OVERLAY_DOOM_BSS_END = .;
    ASSERT(ABSOLUTE(_OVERLAY_DOOM_BSS_END) < __RAM_EMU_END__, "Error: DOOM BSS overflow");

    /* ---- next-hack engine 256KB short-pointer window (USE_NHDOOM, Phase 2) ----
       The engine packs zone-block pointers as 16-bit (offset>>2) relative to a
       256KB-aligned base (RAM_PTR_BASE). Only staticZone is short-pointer'd, so
       it MUST sit inside one 256KB window; we 256KB-align here, publish
       nh_ram_window_base, and place staticZone (.displayData_bss) at the base,
       followed by the engine's other writable bss. host-proven footprint is
       ~193KB < 256KB. DTCM (128KB) is too small; AXI SRAM (RAM_EMU) is the only
       region that fits, hence the placement here. Empty when USE_NHDOOM=0. */
    . = ALIGN(0x40000);
    nh_ram_window_base = .;
    __nhdoom_window_start = .;
    /* Reserve the first 8-byte CHUNK (short-pointer 0). The engine's
       getLongPtrDW() treats a packed short-pointer of 0 as NULL, so anything
       landing at the window base (>>3 == 0) is unaddressable. memzone_t puts
       .blocklist at offset 0, so with staticZone exactly at the base,
       Z_Init's `block->next = getShortPtrDW(&mainzone->blocklist)` == 0 == NULL
       and Z_Malloc2 traps (udf) on the broken ring. Pushing staticZone one
       chunk up makes its lowest packed pointer 1, mirroring the original nRF
       build where short-ptr 0 is naturally unused. RAM_PTR_BASE stays
       256KB-aligned so the `base | (sptr<<3)` reconstruction is unaffected. */
    . = . + 8;
    build/nhdoom/*.o (.displayData_bss)   /* staticZone[113600] at window base + 8 */
    build/nhdoom/*.o (.openings_bss)
    build/nhdoom/*.o (.bss .bss*)
    . = ALIGN(4);
    build/nhdoom/*.o (COMMON)
    . = ALIGN(4);
    __nhdoom_window_end = .;
    _OVERLAY_NHDOOM_BSS_END = .;
    ASSERT((__nhdoom_window_end - nh_ram_window_base) <= 0x40000,
           "Error: nhdoom 256KB short-pointer window overflow");
    ASSERT(ABSOLUTE(_OVERLAY_NHDOOM_BSS_END) < __RAM_EMU_END__, "Error: NHDOOM BSS overflow");
  }
  _OVERLAY_DOOM_BSS_SIZE = SIZEOF(.overlay_doom_bss);

  /* Wolfenstein 3D homebrew overlay (SD build: overlay LMA region is CORES). */
  .overlay_wolf3d __RAM_EMU_START__ : {
    . = ALIGN(4);
    __ram_emu_wolf3d_start__ = .;
    build/wolf3d/*.o (.data .data* .text .text* .rodata .rodata*)
    . = ALIGN(4);
    _OVERLAY_WOLF3D_LOAD_END = .;
  } AT > CORES
  _OVERLAY_WOLF3D_LOAD_START = LOADADDR(.overlay_wolf3d);
  _OVERLAY_WOLF3D_SIZE = SIZEOF(.overlay_wolf3d);

  .overlay_wolf3d_bss _OVERLAY_WOLF3D_LOAD_END : {
    . = ALIGN(4);
    _OVERLAY_WOLF3D_BSS_START = .;
    build/wolf3d/*.o (.bss .bss*)
    . = ALIGN(4);
    build/wolf3d/*.o (COMMON)
    __ram_emu_wolf3d_end__ = .;
    _OVERLAY_WOLF3D_BSS_END = .;
    ASSERT(ABSOLUTE(_OVERLAY_WOLF3D_BSS_END) < __RAM_EMU_END__, "Error: WOLF3D BSS overflow");
  }
  _OVERLAY_WOLF3D_BSS_SIZE = SIZEOF(.overlay_wolf3d_bss);

  /* PICO-8 stub overlay → RAM, placed at HIGH end of RAM_EMU.
     The GPL build only includes the install-prompt stub (main_pico8_stub.c).
     The real engine is loaded from /cores/pico8.bin at runtime, replacing
     this stub in memory.

     Stub is tiny but the SAME VMA must be used for the runtime-loaded
     pico8.bin so the engine's link-time RAM references resolve correctly.

     Layout — engine lives at the LOW end of the LCD bonus area:
       __RAM_UC_START__              = 0x24000000
       _PICO8_FB_OFFSET (LUT8 fb)    = 0x025800   (154 KB)
       __overlay_pico8_vma           = 0x24026800
       engine end (BSS_END, varies)
       TLSF main pool starts here, runs to __RAM_EMU_END__ = 0x24100000

     The LCD MUST be in LUT8 mode when pico8.bin is loaded into this
     range, otherwise the load overwrites the active RGB565 framebuffer.
     rg_emulators.c calls lcd_setup_framebuffers(LCD_MODE_LUT8) before
     load_core_bin_with_header("/cores/pico8.bin", ...).

     Why a fixed low-end address: GPL never has to know the engine's
     size. The engine's own entry trampoline zeroes BSS at startup
     (equivalent of crt0), and the SD-side main_pico8.c computes the
     TLSF pool from _OVERLAY_PICO8_BSS_END..__RAM_EMU_END__. So the
     engine can grow freely without anyone rebuilding GPL — only the
     SD binaries need updating. */
  _PICO8_FB_OFFSET = 2 * 320 * 240;          /* LUT8 framebuffer = 154 KB */
  __overlay_pico8_vma = __RAM_UC_START__ + _PICO8_FB_OFFSET;

  .overlay_pico8 __overlay_pico8_vma : {
    . = ALIGN(4);
    __ram_emu_pico8_start__ = .;
    KEEP(*(.pico8_entry))
    _PICO8_MAIN_CODE_START = .;
    build/pico8/main_pico8_stub.o (.text .text* .data .data* .rodata .rodata*)
    _PICO8_MAIN_CODE_END = .;
    . = ALIGN(4);
    _OVERLAY_PICO8_LOAD_END = .;
  }
  _OVERLAY_PICO8_LOAD_START = LOADADDR(.overlay_pico8);
  _OVERLAY_PICO8_SIZE = SIZEOF(.overlay_pico8);

  .overlay_pico8_bss _OVERLAY_PICO8_LOAD_END : {
    . = ALIGN(4);
    _OVERLAY_PICO8_BSS_START = .;
    build/pico8/*.o (.bss .bss*)
    . = ALIGN(4);
    build/pico8/*.o (COMMON)
    __ram_emu_pico8_end__ = .;
    _OVERLAY_PICO8_BSS_END = .;
    ASSERT(ABSOLUTE(_OVERLAY_PICO8_BSS_END) <= __RAM_EMU_END__,
           "Error: PICO8 engine + BSS would overflow RAM_EMU and leave no room for the TLSF pool");
  }
  _OVERLAY_PICO8_BSS_SIZE = SIZEOF(.overlay_pico8_bss);

  .overlay_tama __RAM_EMU_START__ : {
    . = ALIGN(4);
    __ram_emu_tama_start__ = .;
    build/tama/*.o (.data .data* .text .text* .rodata .rodata*)
    . = ALIGN(4);
    _OVERLAY_TAMA_LOAD_END = .;
  } AT > CORES
  _OVERLAY_TAMA_LOAD_START = LOADADDR(.overlay_tama);
  _OVERLAY_TAMA_SIZE = SIZEOF(.overlay_tama);

  .overlay_tama_bss _OVERLAY_TAMA_LOAD_END : {
    . = ALIGN(4);
    _OVERLAY_TAMA_BSS_START = .;
    build/tama/*.o (.bss .bss*)
    . = ALIGN(4);
    build/tama/*.o (COMMON)
    __ram_emu_tama_end__ = .;
    _OVERLAY_TAMA_BSS_END = .;
    ASSERT(ABSOLUTE(_OVERLAY_TAMA_BSS_END) < __RAM_EMU_END__, "Error: TAMA BSS overflow");
  }
  _OVERLAY_TAMA_BSS_SIZE = SIZEOF(.overlay_tama_bss);

  .overlay_pkmini __RAM_EMU_START__ : {
    . = ALIGN(4);
    __ram_emu_pkmini_start__ = .;
    build/pkmini/*.o (.data .data* .text .text* .rodata .rodata*)
    . = ALIGN(4);
    _OVERLAY_PKMINI_LOAD_END = .;
  } AT > CORES
  _OVERLAY_PKMINI_LOAD_START = LOADADDR(.overlay_pkmini);
  _OVERLAY_PKMINI_SIZE = SIZEOF(.overlay_pkmini);

  .overlay_pkmini_bss _OVERLAY_PKMINI_LOAD_END : {
    . = ALIGN(4);
    _OVERLAY_PKMINI_BSS_START = .;
    build/pkmini/*.o (.bss .bss*)
    . = ALIGN(4);
    build/pkmini/*.o (COMMON)
    __ram_emu_pkmini_end__ = .;
    _OVERLAY_PKMINI_BSS_END = .;
    ASSERT(ABSOLUTE(_OVERLAY_PKMINI_BSS_END) < __RAM_EMU_END__, "Error: PKMINI BSS overflow");
  }
  _OVERLAY_PKMINI_BSS_SIZE = SIZEOF(.overlay_pkmini_bss);

  .overlay_graphics : {
    . = ALIGN(4);
    KEEP(*(.sdcard_logo))
    . = ALIGN(4);  /* pad the LAST logo so logo.bin readers don't over-read it */
  } > CORES

  ._ram_space_check_md : {
    . = . + SIZEOF(.overlay_md);
    . = . + SIZEOF(.overlay_md_bss);
  } >RAM_EMU

  /* only use ahb_malloc/ahb_calloc to use ahb memory ! */
  /* only audio buffer is statically allocated */
  ._ahbram (NOLOAD) :
  {
    __ahbram_start__ = .;
    . = ALIGN(4);
    __ahbram_heap_start__ = .;
    . = ORIGIN(AHBRAM) + LENGTH(AHBRAM) - __AHBRAM_AUDIO_RESERVE__;
    __ahbram_audio_start__ = .;
    *(.audio)
    . = ALIGN(4);
    __ahbram_end__ = .;
  } > AHBRAM

  /* The startup code goes first into FLASH */
  .isr_vector :
  {
    __flash_start__ = .;
    . = ALIGN(4);
    KEEP(*(.isr_vector)) /* Startup code */
    . = ALIGN(4);
  } >FLASH

  /* Firmware ABI table at a fixed offset from intflash start (0x400).
     Plugins (runtime-loaded overlays like the separately-distributed
     PICO-8 engine) resolve the absolute address at load time by reading
     VTOR and adding GW_FIRMWARE_ABI_OFFSET. Works regardless of whether
     the firmware runs from bank 1 (0x08000000) or bank 2 (0x08100000).
     See Core/Inc/retro-go/gw_firmware_abi.h for the contract. */
  .firmware_abi ORIGIN(FLASH) + 0x400 :
  {
    KEEP(*(.firmware_abi))
  } >FLASH

  /* The program code and other data goes into FLASH */
  .text :
  {
    . = ALIGN(4);
    *(.text)           /* .text sections (code) */
    *(.text*)          /* .text* sections (code) */
    *(.glue_7)         /* glue arm to thumb code */
    *(.glue_7t)        /* glue thumb to arm code */
    *(.eh_frame)

    KEEP (*(.init))
    KEEP (*(.fini))

    . = ALIGN(4);
    _etext = .;        /* define a global symbols at end of code */
  } >FLASH

  /* Constant data goes into FLASH */
  .rodata :
  {
    . = ALIGN(4);
    *(.rodata)         /* .rodata sections (constants, strings, etc.) */
    *(.rodata*)        /* .rodata* sections (constants, strings, etc.) */
    _intflash_logo_start = .;
    *(.intflash_logo)
    _intflash_logo_end = .;
    _intflash_global_start = .;
    *(.intflash_global)
    _intflash_global_end = .;
    . = ALIGN(4);
  } >FLASH

  .ARM.extab   : { *(.ARM.extab* .gnu.linkonce.armextab.*) } >FLASH
  .ARM : {
    __exidx_start = .;
    *(.ARM.exidx*)
    __exidx_end = .;
  } >FLASH

  .preinit_array     :
  {
    PROVIDE_HIDDEN (__preinit_array_start = .);
    KEEP (*(.preinit_array*))
    PROVIDE_HIDDEN (__preinit_array_end = .);
  } >FLASH
  .init_array :
  {
    PROVIDE_HIDDEN (__init_array_start = .);
    KEEP (*(SORT(.init_array.*)))
    KEEP (*(.init_array*))
    PROVIDE_HIDDEN (__init_array_end = .);
  } >FLASH
  .fini_array :
  {
    PROVIDE_HIDDEN (__fini_array_start = .);
    KEEP (*(SORT(.fini_array.*)))
    KEEP (*(.fini_array*))
    PROVIDE_HIDDEN (__fini_array_end = .);
  } >FLASH

  /* Force some variables at fixed locations for easy OCD interactions without needing ELF file */
  ._persistent (NOLOAD) :
  {
    . = ALIGN(4);
    __dtcram_start__ = .;
    *(.persistent_boot_magic)
    *(.persistent_log_idx)
    *(.persistent_logbuf)
    . = ALIGN(4);
  } >DTCMRAM

  /* used by the startup to initialize data */
  _sidata = LOADADDR(.data);

  /* Initialized data sections goes into RAM, load LMA copy after code */
  .data :
  {
    . = ALIGN(4);
    _sdata = .;        /* create a global symbol at data start */
    *(.data)           /* .data sections */
    *(.data*)          /* .data* sections */

    . = ALIGN(4);
    _edata = .;        /* define a global symbol at data end */
  } >DTCMRAM AT> FLASH

  ._flash_end :
  {
    . = ALIGN(4);
    __flash_end__ = .;
  } >FLASH

  /* Uninitialized data section */
  . = ALIGN(4);
  .bss :
  {
    _sbss = .;         /* define a global symbol at bss start */
    __bss_start__ = _sbss;
    *(.bss)
    *(.bss*)
    *(COMMON)

    . = ALIGN(4);
    _ebss = .;         /* define a global symbol at bss end */
    __bss_end__ = _ebss;
  } >DTCMRAM

  /* PICO-8 RAM removed — engine allocates 64KB from DTCM heap via dtcm_malloc */

  ._user_heap :
  {
    . = ALIGN(16);
    _heap_start = . ;
    . = . + _Heap_Size;
    . = ALIGN(16);
    _heap_end = . ;
  } >DTCMRAM

  /* User_heap_stack section, used to check that there is enough RAM left */
  ._user_stack :
  {
    /* Pad the unused area between the last symbol and the start of the redzone.
       We reserve space at the top of DTCMRAM for boot magic and remote input if enabled. */
    __dtc_padding_start__ = .;
    . = . + __DTCMRAM_LENGTH__ - __REMOTE_INPUT_RESERVE__ - (_Min_Stack_Size + _Stack_Redzone_Size) - (__dtc_padding_start__ - __dtcram_start__);
    __dtc_padding_end__ = .;

    _stack_redzone = .;
    . = . + _Stack_Redzone_Size;
    _stack_bottom = .;
    . = . + _Min_Stack_Size;
    _stack_top = .;
    . = . + __REMOTE_INPUT_RESERVE__;
    __dtcram_end__ = .;
  } >DTCMRAM

  /* Remove information from the standard libraries */
  /DISCARD/ :
  {
    libc.a ( * )
    libm.a ( * )
    libgcc.a ( * )
  }

  .ARM.attributes 0 : { *(.ARM.attributes) }
}
